## kernel/drivers/input/usac/Kconfig
```kconfig
config INPUT_USAC_SYSCALLS
    bool "USAC syscalls and virtual input devices"
    depends on INPUT
    default y
```

## kernel/drivers/misc/usac/Kconfig
```kconfig
config USAC_SYSCALLS
    tristate "USAC syscalls (practica 2)"
    default y
    help
      Conjunto de syscalls personalizadas para el curso de Sistemas Operativos II.
```
